## conf/layer.conf
```bitbake
# We have a conf and classes directory, add to BBPATH
BBPATH .= ":${LAYERDIR}"

# We have recipes-* directories, add to BBFILES
BBFILES += "${LAYERDIR}/recipes-*/*/*.bb \
            ${LAYERDIR}/recipes-*/*/*.bbappend"

BBFILE_COLLECTIONS += "meta-adlink-qrb5165"
BBFILE_PATTERN_meta-adlink-qualcomm = "^${LAYERDIR}/"
BBFILE_PRIORITY_meta-adlink-qualcomm = "6"

LAYERDEPENDS_meta-adlink-qualcomm = "core"
LAYERSERIES_COMPAT_meta-adlink-qualcomm = "kirkstone"
```
